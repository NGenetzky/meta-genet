## meta-genet-cpp/conf/layer.conf
```bitbake
# We have a conf and classes directory, add to BBPATH
BBPATH .= ":${LAYERDIR}"

# We have recipes-* directories, add to BBFILES
BBFILES += "${LAYERDIR}/recipes-*/*/*.bb \
            ${LAYERDIR}/recipes-*/*/*.bbappend"

BBFILE_COLLECTIONS += "meta-genet-cpp"
BBFILE_PATTERN_meta-genet-cpp = "^${LAYERDIR}/"
BBFILE_PRIORITY_meta-genet-cpp = "6"
```

## meta-genet-python/conf/layer.conf
```bitbake
# We have a conf and classes directory, add to BBPATH
BBPATH .= ":${LAYERDIR}"

# We have recipes-* directories, add to BBFILES
BBFILES += "${LAYERDIR}/recipes-*/*/*.bb \
            ${LAYERDIR}/recipes-*/*/*.bbappend"

BBFILE_COLLECTIONS += "meta-genet-python"
BBFILE_PATTERN_meta-genet-python = "^${LAYERDIR}/"
BBFILE_PRIORITY_meta-genet-python = "6"
```
